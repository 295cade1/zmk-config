## boards/shields/Hubris58/Kconfig.defconfig
```kconfig
if SHIELD_HUBRIS58_LEFT

# Name must be less than 16 characters long!
config ZMK_KEYBOARD_NAME
    default "hubris58"

config ZMK_SPLIT_ROLE_CENTRAL
    default y

endif

if SHIELD_HUBRIS58_LEFT || SHIELD_HUBRIS58_RIGHT

config ZMK_SPLIT
    default y

endif
```

## boards/shields/Hubris58/Kconfig.shield
```kconfig
# No whitespace after the comma or in your part name!
config SHIELD_HUBRIS58_LEFT
    def_bool $(shields_list_contains,hubris58_left)

# No whitespace after the comma or in your part name!
config SHIELD_HUBRIS58_RIGHT
    def_bool $(shields_list_contains,hubris58_right)
```
